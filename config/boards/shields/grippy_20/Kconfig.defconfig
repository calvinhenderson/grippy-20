## config/boards/shields/grippy_20/Kconfig.defconfig
```kconfig
if SHIELD_GRIPPY_20_LEFT

    # Name must be less than 16 characters long!
    config ZMK_KEYBOARD_NAME
        default "Grippy 20"

    config ZMK_SPLIT_ROLE_CENTRAL
        default y

    endif

if SHIELD_GRIPPY_20_LEFT || SHIELD_GRIPPY_20_RIGHT

    config ZMK_BLE
        default y

    config ZMK_USB
        default y

    config ZMK_SPLIT
        default y

    endif
```

## config/boards/shields/grippy_20/Kconfig.shield
```kconfig
config SHIELD_GRIPPY_20_LEFT
    def_bool $(shields_list_contains,grippy_20_left)

    config ZMK_COMBO_MAX_PRESSED_COMBOS
        default 8

    config ZMK_COMBO_MAX_COMBOS_PER_KEY
        default 32

    config ZMK_COMBO_MAX_KEYS_PER_COMBO
        default 8


    config SYSTEM_WORKQUEUE_STACK_SIZE
        int "work queue stack size"
        default 4096

    config CONFIG_MAIN_STACK_SIZE
        int "main stack size"
        default 2048

config SHIELD_GRIPPY_20_RIGHT
    def_bool $(shields_list_contains,grippy_20_right)

    # config ZMK_COMBO_MAX_PRESSED_COMBOS
    #     default 8

    # config ZMK_COMBO_MAX_COMBOS_PER_KEY
    #     default 32

    # config ZMK_COMBO_MAX_KEYS_PER_COMBO
    #     default 8


    # config SYSTEM_WORKQUEUE_STACK_SIZE
    #     int "work queue stack size"
    #     default 4096

    # config CONFIG_MAIN_STACK_SIZE
    #     int "main stack size"
    #     default 2048
```

## config/west.yml
```yaml
manifest:
  remotes:
    - name: zmkfirmware
      url-base: https://github.com/zmkfirmware
    - name: calvinhenderson
      url-base: https://github.com/calvinhenderson
  projects:
    - name: zmk-dynamic-macros
      path: zmk
      remote: calvinhenderson
      revision: feat-dynamic-macros
      import: app/west.yml
  self:
    path: config
```
